## configs/idl4k_defconfig
```kconfig
BR2_sh=y
BR2_TOOLCHAIN_BUILDROOT_VENDOR="idl4k"
BR2_KERNEL_HEADERS_CUSTOM_GIT=y
BR2_KERNEL_HEADERS_CUSTOM_REPO_URL="https://github.com/ast261/sh4_kernel_idl4k"
BR2_KERNEL_HEADERS_CUSTOM_REPO_VERSION="da3728b1037d96a3ec1acf8e18cdaf9d4c67249b"
BR2_BINUTILS_VERSION_2_45_X=y
BR2_GCC_VERSION_15_X=y
BR2_TOOLCHAIN_BUILDROOT_CXX=y
BR2_PACKAGE_HOST_GDB=y
BR2_PACKAGE_HOST_GDB_PYTHON3=y
BR2_GDB_VERSION_16=y
BR2_CURL="curl -q --ftp-pasv --retry 3"
BR2_WGET="wget --passive-ftp -nd -t 3 --no-check-certificate"
BR2_SVN="svn"
BR2_SCP="scp"
BR2_SFTP="sftp"
BR2_HOST_DIR="$(TOPDIR)/output/sh-sh4--glibc--stable"
BR2_BACKUP_SITE="http://sources.buildroot.net"
BR2_GNU_MIRROR="http://ftpmirror.gnu.org"
BR2_CPAN_MIRROR="http://cpan.metacpan.org"
BR2_OPTIMIZE_S=y
# BR2_PIC_PIE is not set
BR2_RELRO_NONE=y
BR2_TARGET_GENERIC_HOSTNAME="idl4k"
BR2_TARGET_GENERIC_ISSUE="Welcome to idl4k"
BR2_ROOTFS_DEVICE_CREATION_STATIC=y
BR2_ROOTFS_STATIC_DEVICE_TABLE="board/idl4k/device_table_dev.txt"
BR2_TARGET_GENERIC_ROOT_PASSWD="idl4k"
# BR2_TARGET_GENERIC_GETTY is not set
BR2_SYSTEM_DHCP="eth0"
BR2_TARGET_TZ_INFO=y
BR2_TARGET_LOCALTIME="Europe/Paris"
BR2_ROOTFS_OVERLAY="board/idl4k/rootfs"
BR2_ROOTFS_POST_IMAGE_SCRIPT="board/idl4k/post-build.sh"
BR2_LINUX_KERNEL=y
BR2_LINUX_KERNEL_CUSTOM_GIT=y
BR2_LINUX_KERNEL_CUSTOM_REPO_URL="https://github.com/ast261/sh4_kernel_idl4k"
BR2_LINUX_KERNEL_CUSTOM_REPO_VERSION="da3728b1037d96a3ec1acf8e18cdaf9d4c67249b"
BR2_LINUX_KERNEL_DEFCONFIG="idl4k"
BR2_LINUX_KERNEL_IMAGE_TARGET_CUSTOM=y
BR2_LINUX_KERNEL_IMAGE_TARGET_NAME="uImage.gz"
BR2_PACKAGE_BUSYBOX_CONFIG="board/idl4k/busybox.config"
BR2_PACKAGE_GDB=y
BR2_PACKAGE_STRACE=y
BR2_PACKAGE_MTD=y
BR2_PACKAGE_MTD_JFFS2DUMP=y
BR2_PACKAGE_MTD_MKFSJFFS2=y
# BR2_PACKAGE_MTD_UBIATTACH is not set
# BR2_PACKAGE_MTD_UBICRC32 is not set
# BR2_PACKAGE_MTD_UBIDETACH is not set
# BR2_PACKAGE_MTD_UBIFORMAT is not set
# BR2_PACKAGE_MTD_UBIMKVOL is not set
# BR2_PACKAGE_MTD_UBINFO is not set
# BR2_PACKAGE_MTD_UBINIZE is not set
# BR2_PACKAGE_MTD_UBIRENAME is not set
# BR2_PACKAGE_MTD_UBIRMVOL is not set
# BR2_PACKAGE_MTD_UBIRSVOL is not set
# BR2_PACKAGE_MTD_UBIUPDATEVOL is not set
# BR2_PACKAGE_MTD_UBIBLOCK is not set
BR2_PACKAGE_LZO=y
BR2_PACKAGE_LIBDVBCSA=y
BR2_PACKAGE_DROPBEAR=y
BR2_PACKAGE_ETHTOOL=y
BR2_PACKAGE_OPENSSH=y
# BR2_PACKAGE_OPENSSH_SERVER is not set
# BR2_PACKAGE_OPENSSH_KEY_UTILS is not set
BR2_PACKAGE_RSYNC=y
BR2_PACKAGE_HTOP=y
BR2_PACKAGE_NANO=y
BR2_PACKAGE_SH4_TOOLCHAIN_GCC=y
BR2_PACKAGE_MINISATIP=y
BR2_PACKAGE_OSCAM=y
BR2_TARGET_ROOTFS_INITRAMFS=y
# BR2_TARGET_ROOTFS_TAR is not set
BR2_PACKAGE_HOST_UBOOT_TOOLS=y
```

## configs/idl4k_toolchain_defconfig
```kconfig
BR2_sh=y
BR2_TOOLCHAIN_BUILDROOT_VENDOR="idl4k"
BR2_KERNEL_HEADERS_CUSTOM_GIT=y
BR2_KERNEL_HEADERS_CUSTOM_REPO_URL="https://github.com/ast261/sh4_kernel_idl4k"
BR2_KERNEL_HEADERS_CUSTOM_REPO_VERSION="da3728b1037d96a3ec1acf8e18cdaf9d4c67249b"
BR2_BINUTILS_VERSION_2_45_X=y
BR2_GCC_VERSION_15_X=y
BR2_TOOLCHAIN_BUILDROOT_CXX=y
BR2_PACKAGE_HOST_GDB=y
BR2_PACKAGE_HOST_GDB_PYTHON3=y
BR2_GDB_VERSION_16=y
BR2_CURL="curl -q --ftp-pasv --retry 3"
BR2_WGET="wget --passive-ftp -nd -t 3 --no-check-certificate"
BR2_SVN="svn"
BR2_SCP="scp"
BR2_SFTP="sftp"
BR2_HOST_DIR="$(TOPDIR)/output/sh-sh4--glibc--stable"
BR2_BACKUP_SITE="http://sources.buildroot.net"
BR2_GNU_MIRROR="http://ftpmirror.gnu.org"
BR2_CPAN_MIRROR="http://cpan.metacpan.org"
BR2_OPTIMIZE_S=y
# BR2_PIC_PIE is not set
BR2_RELRO_NONE=y
BR2_TARGET_GENERIC_HOSTNAME="idl4k"
BR2_TARGET_GENERIC_ISSUE="Welcome to idl4k"
BR2_INIT_NONE=y
BR2_SYSTEM_BIN_SH_NONE=y
# BR2_PACKAGE_BUSYBOX is not set
BR2_PACKAGE_GDB=y
# BR2_PACKAGE_IFUPDOWN_SCRIPTS is not set
# BR2_TARGET_ROOTFS_TAR is not set
```

## package/minisatip_legacy/Config.in
```kconfig
config BR2_PACKAGE_MINISATIP_LEGACY
	bool "minisatip_legacy"
	help
          minisatip
          
```
