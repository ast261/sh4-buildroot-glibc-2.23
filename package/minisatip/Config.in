## package/minisatip/Config.in
```kconfig
config BR2_PACKAGE_MINISATIP
	bool "minisatip"
	help
          minisatip
          
```

## package/sh4-toolchain-gcc/Config.in
```kconfig
config BR2_PACKAGE_SH4_TOOLCHAIN_GCC
  bool "idl4k-kernel-toolchain"
  help
     idl4k sh4 kernel toolchain
```
